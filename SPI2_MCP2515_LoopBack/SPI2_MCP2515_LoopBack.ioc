# file: SPI2_MCP2515_LoopBack.ioc
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Mcu.Family=STM32F4
Mcu.Name=STM32F407V(E-G)Tx
Mcu.Package=LQFP100
NVIC.PriorityGroup=NVIC_PRIORITYGROUP_0
PA13.Mode=Serial_Wire
PA13.Signal=SYS_JTMS-SWDIO
PA14.Mode=Serial_Wire
PA14.Signal=SYS_JTCK-SWCLK
PH0-OSC_IN.Mode=HSE-External-Oscillator
PH0-OSC_IN.Signal=RCC_OSC_IN
PH1-OSC_OUT.Mode=HSE-External-Oscillator
PH1-OSC_OUT.Signal=RCC_OSC_OUT
ProjectManager.HeapSize=0x200
ProjectManager.StackSize=0x400
ProjectManager.TargetToolchain=STM32CubeIDE
RCC.48MHZClocksFreq_Value=18285714.285714287
RCC.AHBFreq_Value=64000000
RCC.APB1CLKDivider=RCC_HCLK_DIV2
RCC.APB1Freq_Value=32000000
RCC.APB1TimFreq_Value=64000000
RCC.APB2CLKDivider=RCC_HCLK_DIV2
RCC.APB2Freq_Value=32000000
RCC.APB2TimFreq_Value=64000000
RCC.CortexFreq_Value=64000000
RCC.HCLKFreq_Value=64000000
RCC.HSE_VALUE=8000000
RCC.HSI_VALUE=16000000
RCC.PLLM=4
RCC.PLLN=64
RCC.PLLQ=7
RCC.PLLSourceVirtual=RCC_PLLSOURCE_HSE
RCC.SYSCLKFreq_VALUE=64000000
RCC.SYSCLKSource=RCC_SYSCLKSOURCE_PLLCLK
RCC.VCOOutputFreq_Value=128000000
board=STM32F407G-DISC1

// file: Core/Src/main.c
/* USER CODE BEGIN Header */
/**
  ******************************************************************************
  * @file           : main.c
  * @brief          : Main program body
  ******************************************************************************
  * @attention
  *
  * Copyright (c) 2026 STMicroelectronics.
  * All rights reserved.
  *
  * This software is licensed under terms that can be found in the LICENSE file
  * in the root directory of this software component.
  * If no LICENSE file comes with this software, it is provided AS-IS.
  *
  ******************************************************************************
  */
/* USER CODE END Header */
#include "main.h"

/* USER CODE BEGIN Includes */
#include "stdio.h"
#include "spi.h"
#include "usart.h"
#include "mcp2515.h"
#include "max7219.h"

/* USER CODE END Includes */

/* USER CODE BEGIN PV */

extern const uint8_t font_8x8_digits[10][8];
extern const uint8_t font_8x8_alpha[26][8];
extern const uint8_t font_space[8];

/* USER CODE END PV */

void SystemClock_Config(void);
static void MX_GPIO_Init(void);

int main(void)
{

  /* USER CODE BEGIN 1 */

	uint16_t id = 0x123;
	uint8_t dlc_len = 0x2;
	uint8_t msg[] = {0x11, 0x22};

	uint16_t rx_id = 0;
	uint8_t rx_dlc_len = 0;
	uint8_t rx_msg[8] = {0,0,0,0,0,0,0,0};

	uint8_t uart_msg_tx[100];
	uint8_t uart_msg_rx[100];

  /* USER CODE END 1 */

  /* MCU Configuration--------------------------------------------------------*/

  /* Reset of all peripherals, Initializes the Flash interface and the Systick. */
  HAL_Init();

  /* Configure the system clock */
  SystemClock_Config();

  /* Initialize all configured peripherals */
  MX_GPIO_Init();
  /* USER CODE BEGIN 2 */

  USART2_Init();

  USART2_SendString("UART Initialized....!!\r\n");

  SPI2_GPIO_Init();
  SPI2_Init();
  USART2_SendString("SPI Initialized.....!!\r\n");

  SPI2_Test();

  // Initialize MCP and move to loopback mode
  MCP2515_Init();

  //Enter loopback mode
  MCP2515_SetMode(MCP2515_MODE_LOOPBACK);

  //check and wait till loopback mode
  while((MCP2515_ReadRegister(MCP2515_CANSTAT) & MCP2515_MODE_MASK) != MCP2515_MODE_LOOPBACK);

  uint8_t canstat = MCP2515_ReadRegister(MCP2515_CANSTAT);

  if((canstat & MCP2515_MODE_MASK) == MCP2515_MODE_LOOPBACK)
  {
      USART2_SendString("MCP2515 Loopback mode OK\r\n");
  }
  else
  {
      USART2_SendString("MCP2515 Loopback mode failed\r\n");
  }

  // Simple hardware test
  MAX7219_Write(0x0F, 0x01);   // All LEDs ON
  HAL_Delay(2000);
  MAX7219_Write(0x0F, 0x00);   // Test OFF

  MAX7219_Init();
  MAX7219_Clear();

  /* USER CODE END 2 */

  /* Infinite loop */
  /* USER CODE BEGIN WHILE */
  while (1)
  {

	  //Transmitting standard CAN frame
	  MCP2515_SendMessage(id,msg,dlc_len);
	  sprintf(uart_msg_tx,"Message Transmitted : ID = 0x%02X, DLC = 0x%02X, DATA1 = 0x%02X, DATA2 = 0x%02X\r\n",id,dlc_len,msg[0],msg[1]);
	  USART2_SendString(uart_msg_tx);

	  //Receiving frame
	  MCP2515_ReadMessage(&rx_id,rx_msg,&rx_dlc_len);
	  sprintf(uart_msg_rx,"Message Received : ID = 0x%02X, DLC = 0x%02X, DATA1 = 0x%02X, DATA2 = 0x%02X\r\n",rx_id,rx_dlc_len,rx_msg[0],rx_msg[1]);
	  USART2_SendString(uart_msg_rx);

	  MAX7219_CharBlinking('A');
	  //MAX7219_StringBlinking("Hello Via Matrix");

	  //MAX7219_ScrollText_RtoL("HELLO", 100);

    /* USER CODE END WHILE */

  }
}

void SystemClock_Config(void)
{
  RCC_OscInitTypeDef RCC_OscInitStruct = {0};
  RCC_ClkInitTypeDef RCC_ClkInitStruct = {0};

  /** Configure the main internal regulator output voltage
  */
  __HAL_RCC_PWR_CLK_ENABLE();
  __HAL_PWR_VOLTAGESCALING_CONFIG(PWR_REGULATOR_VOLTAGE_SCALE1);

  /** Initializes the RCC Oscillators according to the specified parameters
  * in the RCC_OscInitTypeDef structure.
  */
  RCC_OscInitStruct.OscillatorType = RCC_OSCILLATORTYPE_HSE;
  RCC_OscInitStruct.HSEState = RCC_HSE_ON;
  RCC_OscInitStruct.PLL.PLLState = RCC_PLL_ON;
  RCC_OscInitStruct.PLL.PLLSource = RCC_PLLSOURCE_HSE;
  RCC_OscInitStruct.PLL.PLLM = 4;
  RCC_OscInitStruct.PLL.PLLN = 64;
  RCC_OscInitStruct.PLL.PLLP = RCC_PLLP_DIV2;
  RCC_OscInitStruct.PLL.PLLQ = 7;
  if (HAL_RCC_OscConfig(&RCC_OscInitStruct) != HAL_OK)
  {
    Error_Handler();
  }

  /** Initializes the CPU, AHB and APB buses clocks
  */
  RCC_ClkInitStruct.ClockType = RCC_CLOCKTYPE_HCLK|RCC_CLOCKTYPE_SYSCLK
                              |RCC_CLOCKTYPE_PCLK1|RCC_CLOCKTYPE_PCLK2;
  RCC_ClkInitStruct.SYSCLKSource = RCC_SYSCLKSOURCE_PLLCLK;
  RCC_ClkInitStruct.AHBCLKDivider = RCC_SYSCLK_DIV1;
  RCC_ClkInitStruct.APB1CLKDivider = RCC_HCLK_DIV2;
  RCC_ClkInitStruct.APB2CLKDivider = RCC_HCLK_DIV2;

  if (HAL_RCC_ClockConfig(&RCC_ClkInitStruct, FLASH_LATENCY_2) != HAL_OK)
  {
    Error_Handler();
  }
}

static void MX_GPIO_Init(void)
{

  /* GPIO Ports Clock Enable */
  __HAL_RCC_GPIOH_CLK_ENABLE();
  __HAL_RCC_GPIOA_CLK_ENABLE();

}

void Error_Handler(void)
{
  __disable_irq();
  while (1)
  {
  }
}
